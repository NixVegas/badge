## pkgs/firmware/cvitek_sg2000_milkv_duos_glibc_arm64_sd_defconfig
```kconfig
CONFIG_ARM=y
CONFIG_TARGET_CVITEK_ARM=y
CONFIG_TARGET_CVITEK_CV181X=y
CONFIG_TARGET_CVITEK_CV181X_ASIC=y
CONFIG_SYS_TEXT_BASE=0x80200000
CONFIG_SYS_MALLOC_F_LEN=0x8000
CONFIG_NR_DRAM_BANKS=1
CONFIG_ARMV8_SET_SMPEN=y
CONFIG_IDENT_STRING=" cvitek cv181x"
CONFIG_BOOTDELAY=3
CONFIG_DEFAULT_DEVICE_TREE="cv181x_cv181xasic"
CONFIG_OF_EMBED=y
CONFIG_ENV_IS_IN_MMC=y
CONFIG_ENV_SIZE=0x20000
CONFIG_ENV_SECT_SIZE=0x40000
CONFIG_ENV_OFFSET=0x880000
CONFIG_SYS_RELOC_GD_ENV_ADDR=y
# CONFIG_CMD_CVI_UPDATE is not set
# CONFIG_CMD_BOOT_MODE_NAND is not set
# CONFIG_DISPLAY_CPUINFO is not set
CONFIG_USE_DEFAULT_ENV=y
CONFIG_SYS_MMC_ENV_DEV=0
# MMC/SD: cvitek sdhci driver (sdhci-mars.c, of_match "cvitek,cv181x-sd")
CONFIG_MMC=y
CONFIG_DM_MMC=y
CONFIG_MMC_SDHCI=y
CONFIG_MMC_SDHCI_SDMA=y
CONFIG_MMC_SDHCI_CVITEK=y
# MMC IO voltage and UHS support (required by mars-asic.h CONFIG_MMC_UHS_SUPPORT)
CONFIG_MMC_IO_VOLTAGE=y
CONFIG_MMC_UHS_SUPPORT=y
CONFIG_MMC_HS200_SUPPORT=y
CONFIG_MMC_SUPPORTS_TUNING=y
CONFIG_DM=y
CONFIG_SYS_LONGHELP=y
CONFIG_SYS_PROMPT="cv181x# "
CONFIG_LZMA=y
# Shell: enable hush so sysboot and multi-command sequences work
CONFIG_HUSH_PARSER=y
CONFIG_CMD_MEMORY=y
CONFIG_CMD_MMC=y
CONFIG_CMD_PART=y
CONFIG_CMD_FAT=y
CONFIG_CMD_EXT2=y
CONFIG_CMD_EXT4=y
# sysboot/extlinux support
CONFIG_CMD_SYSBOOT=y
CONFIG_CMD_FS_GENERIC=y
CONFIG_CMD_BOOTI=y
CONFIG_SUPPORT_RAW_INITRD=y
CONFIG_FAT_WRITE=y
CONFIG_FS_FAT=y
CONFIG_FS_EXT4=y
CONFIG_OF_CONTROL=y
# CONFIG_EFI_LOADER is not set
CONFIG_SYS_NS16550=y
```
